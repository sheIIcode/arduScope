#include <Adafruit_GFX.h>    // Core graphics library
#include <Adafruit_ST7735.h> // Hardware-specific library for ST7735
#include <SPI.h>

#define TFT_DC PB8
#define TFT_CS PB6
#define TFT_RST PB7
    
  uint16_t Input = PA0;  
  uint16_t Key_add = PB12; 
  uint16_t Key_sub = PA12;
  uint16_t Key_hold = PA15;
  uint16_t x,y; 
  uint16_t i,i1,i2,V_min,V_max,V_mid,t,t0,t1,sta,Key=5,hold=0; 
  uint32_t Freq;
  float Vpp;
  uint16_t Y[96];
  uint16_t Buffer[192]; 

  // For 1.44" and 1.8" TFT with ST7735 use:
  Adafruit_ST7735 screen = Adafruit_ST7735(TFT_CS, TFT_DC, TFT_RST);

  char TEXTE[5];
  
  const uint8_t L[] PROGMEM = {

0x00, 0x00, 0x00, 0x00, 0x00, 0x00, 0x00, 0x00, 0x00, 0x00, 0x00, 0x00, 0x00, 0x00, 0x00, 0x00, 
0x00, 0x00, 0x00, 0x00, 0x00, 0x00, 0x00, 0x00, 0x00, 0x00, 0x00, 0x00, 0x00, 0x00, 0x00, 0x00, 
0x00, 0x00, 0x00, 0x00, 0x00, 0x00, 0x00, 0x00, 0x00, 0x00, 0x00, 0x00, 0x00, 0x00, 0x00, 0x00, 
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0x00, 0x00, 0x00, 0x00, 0x00, 0x00, 0x00, 0x00, 0x00, 0x00, 0x00, 0x00, 0x00, 0x00, 0x00, 0x00 



}; 


void setup( )  { 
  Serial.begin(1000000);
  
  pinMode(Key_add,INPUT_PULLUP); 
  digitalWrite(Key_add,HIGH); 
  pinMode(Key_sub,INPUT_PULLUP);
  digitalWrite(Key_sub,HIGH); 
  pinMode(Key_hold,INPUT_PULLUP);
  digitalWrite(Key_hold,HIGH); 
   
  screen.initR(INITR_BLACKTAB);      // Init ST7735S chip, black tab
  screen.setRotation(1);
  screen.fillScreen(ST77XX_BLACK);
  delay(200);

   
   /*
   screen.setFont(screen_font_5x7); 
    screen.firstPage();  
   do {
    screen.drawBitmapP( 0, 0, 16, 64, L); 
    } while( screen.nextPage() );

    */
 } 
 
void loop( ) 
 { 
   sample( );
   Measure( ); 
   Transform( );
   Key_scan( );
   if(hold==0) { // when not on hold
     draw( ); 
     delay(50);
   }
   
 } 
 
 void sample( )  {  
  for(i = 0;i < 192;i++)  {  
    Buffer[i] = analogRead(PA0);
    switch(Key)  {
       case 1:
        break;
       case 2:
         delayMicroseconds(4);  
         break;
       case 3:
         delayMicroseconds(10);
         break;
       case 4:
         delayMicroseconds(23);
         break;
       case 5:
         delayMicroseconds(60);
         break;
       case 6:
         delayMicroseconds(123); 
         break;
       case 7:
         delayMicroseconds(248);
         break;
       case 8:
         delayMicroseconds(623);
         break;
       case 9:
         delayMicroseconds(1247);
         break;
       default: break;
     }
   }
}

void Measure() {
  V_max=Buffer[0];
  V_min=Buffer[0];   
     
  for(i=0;i<192;i++)  { 
    if(Buffer[i]>V_max) 
      V_max=Buffer[i];
    if(Buffer[i]<V_min) 
      V_min=Buffer[i];
  }
  
  V_mid=(V_max+V_min)/2;  
  Vpp=(V_max-V_min)*3.3/4096; // measure come from ADCH so max value is 255

  //find rising edge
  for(i=0;i<97;i++)  {
    if(Buffer[i]<V_mid && Buffer[i+1]>=V_mid) {
      i1=i;
      break;
    }
  }

  //find next rising edge
  for(i=i1+1;i<98+i1;i++) {
    if(Buffer[i]<V_mid && Buffer[i+1]>=V_mid) {
      i2=i;
      break;
    }
  }
  
  t=i2-i1;
  if(t>0)
    Freq=8000/t;
  else
    Freq=0;
}

 void Transform( )  { 
//  find rising endge and save it index in sta variable
  for(sta=0;sta<96;sta++){
    if(Buffer[sta]<128 && Buffer[sta+2]>128)  
      break;
  } 
  
  for(i = 0;i < 96;i++)               // measure come from ADCH so max value is 255, divide by 4 to get 0-64 range
    Y[i] =  63-(Buffer[i+sta]>>6);     // screen Y position starts from 0 on top so substract 63
}                                    // as  y =64 is signal equal to 0 and y = 0 is 5v

void draw( )  {  
  screen.fillScreen(ST77XX_BLACK);

//draw measured values
  for(x = 0;x < 93;x++)  // 93 instead of 95 to offset graph from left border line by 2 pixels (x+2)
    if(abs(Y[x+1] - Y[x]) < 3)
      screen.drawLine(x+2,Y[x],x+1+2,Y[x+1],ST77XX_YELLOW);
    else
      screen.drawLine(x+2,Y[x],x+2,Y[x+1], ST77XX_YELLOW);

  screen.drawRect(0,0,97,64,ST77XX_YELLOW);// outline

  screen.drawLine(48,0,48,63,ST77XX_YELLOW); //vertical middle line
  screen.drawLine(0,32,96,32, ST77XX_YELLOW); // horizontal line

//div marks?
//  for(x=0;x<96;x+=8)
//    screen.drawLine(x,31,x,33);
//  for(y=0;y<64;y+=8)
//    screen.drawLine(47,y,49,y);

  // draw divisions
  for(x=8;x<96;x+=8){
    for(y=8;y<64;y+=8)
      screen.drawPixel(x,y,ST77XX_YELLOW);
  }

  screen.setTextWrap(false);
  screen.setTextSize(1);
  
  screen.setCursor(98,7);
  screen.println("MS/div");
  
//   screen.text("V/div", 98,23);
//   screen.text("0.324",98,30);

  screen.setCursor(98,40);
  screen.println("Vpp");
  String(Vpp).toCharArray(TEXTE,5); 
  screen.setCursor(98,47);
  screen.println(TEXTE);
  screen.setCursor(118,47);
  screen.println("V");
  screen.setCursor(98,55);
  screen.println("F(HZ)");
  
   switch(Key) {
      case  1:
        screen.setCursor(98,14);
        screen.println("0.02");
  
        String(Freq*50).toCharArray(TEXTE,5); 
        screen.setCursor(98,62);
        screen.println(TEXTE);
        break;
  
      case  2:
        screen.setCursor(98,14);
        screen.println("0.05");
        
        String(Freq*20).toCharArray(TEXTE,5); 
        screen.setCursor(98,62);
        screen.println(TEXTE);
        break;
  
      case  3:
        screen.setCursor(98,14);
        screen.println("0.1");
        
        String(Freq*10).toCharArray(TEXTE,5); 
        screen.setCursor(98,62);
        screen.println(TEXTE);
        break;
  
      case  4:
        screen.setCursor(98,14);
        screen.println("0.2");
        
        String(Freq*5).toCharArray(TEXTE,5); 
        screen.setCursor(98,62);
        screen.println(TEXTE);
        break;
  
      case  5:
        screen.setCursor(98,14);
        screen.println("0.5");
        
        String(Freq*2).toCharArray(TEXTE,5); 
        screen.setCursor(98,62);
        screen.println(TEXTE);
        break;
  
      case  6:
        screen.setCursor(98,14);
        screen.println("  1");
        
        String(Freq).toCharArray(TEXTE,5); 
        screen.setCursor(98,62);
        screen.println(TEXTE);
        break;
  
       case  7:
        screen.setCursor(98,14);
        screen.println("  2");
        
        String(Freq/2).toCharArray(TEXTE,5); 
        screen.setCursor(98,62);
        screen.println(TEXTE);
        break;
  
       case  8:
        screen.setCursor(98,14);
        screen.println("  5");
        
        String(Freq/5).toCharArray(TEXTE,5); 
        screen.setCursor(98,62);
        screen.println(TEXTE);
        break;
  
      case  9:
        screen.setCursor(98,14);
        screen.println(" 10");
        
        String(Freq/10).toCharArray(TEXTE,5); 
        screen.setCursor(98,62);
        screen.println(TEXTE);;
        break;
  
      default:
        break;
     }
}


void Key_scan()
{
 if(digitalRead(Key_add)==LOW) 
  {
    while(digitalRead(Key_add)==LOW);
    Key++;
    if(Key==10) Key=9;
    draw();
     
    delay(10);
  } else if (digitalRead(Key_sub)==LOW) {
    while(digitalRead(Key_sub)==LOW);
    Key--;
    if(Key==0) Key=1;
    
    draw();
    delay(10);
  } else if (digitalRead(Key_hold)==LOW) {
    while(digitalRead(Key_hold)==LOW);
    Serial.println("HOLD");
//    for(int i = 0; i < 192; i++){
//      Serial.print(Buffer[i]);
    for(x = 0;x < 95;x++)  {
      Serial.print(Y[x]);
      Serial.print(",");      
    }
    Serial.println();
    
    hold=~hold;
    delay(10);
  }
}
