#include <TFT.h> 
#include <SPI.h>

#define cs 10
#define dc 9
#define rst 8

 int Input = A0;  
 int Key_add = 4; 
 int Key_sub = 5;
 int Key_hold = 6;
 int x,y; 
 int i,i1,i2,V_min,V_max,V_mid,t,t0,t1,sta,Key=5,hold=0; 
 long Freq;
 float Vpp;
 int Y[96];
 int Buffer[192]; 
 TFT screen = TFT(cs, dc, rst);
 char TEXTE[5];
 
 const uint8_t L[] PROGMEM = {

0x00, 0x00, 0x00, 0x00, 0x00, 0x00, 0x00, 0x00, 0x00, 0x00, 0x00, 0x00, 0x00, 0x00, 0x00, 0x00, 
0x00, 0x00, 0x00, 0x00, 0x00, 0x00, 0x00, 0x00, 0x00, 0x00, 0x00, 0x00, 0x00, 0x00, 0x00, 0x00, 
0x00, 0x00, 0x00, 0x00, 0x00, 0x00, 0x00, 0x00, 0x00, 0x00, 0x00, 0x00, 0x00, 0x00, 0x00, 0x00, 
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0x00, 0x00, 0x00, 0x00, 0x00, 0x00, 0x00, 0x00, 0x00, 0x00, 0x00, 0x00, 0x00, 0x00, 0x00, 0x00 



}; 

 void setup( ) 
 { 
   Serial.begin(1000000);
   
   pinMode(Key_add,INPUT); 
   digitalWrite(Key_add,HIGH); 
   pinMode(Key_sub,INPUT);
   digitalWrite(Key_sub,HIGH); 
   pinMode(Key_hold,INPUT);
   digitalWrite(Key_hold,HIGH); 
   ADMUX=0x60;  
   ADCSRA=0xe2; 
   screen.begin();

   screen.background(0,0,0);
   screen.stroke(122, 122, 122);
   
   /*
   screen.setFont(screen_font_5x7); 
    screen.firstPage();  
   do {
    screen.drawBitmapP( 0, 0, 16, 64, L); 
    } while( screen.nextPage() );

    */

   delay(1000); 
 } 
 
void loop( ) 
 { 
   sample( );
   Measure( ); 
   Transform( );
   Key_scan( );
   if(hold==0) // when not on hold
   {
     draw( ); 
     delay(300);
   }
   
 } 
 
 void sample( )  
{  for(i = 0;i < 192;i++)
   {  
    Buffer[i] = ADCH;
    switch(Key)
     {
       case 1:
       break;
       case 2:
       delayMicroseconds(4);  
       break;
       case 3:
       delayMicroseconds(10);
       break;
       case 4:
       delayMicroseconds(23);
       break;
       case 5:
       delayMicroseconds(60);
       break;
       case 6:
       delayMicroseconds(123); 
       break;
       case 7:
       delayMicroseconds(248);
       break;
       case 8:
       delayMicroseconds(623);
       break;
       case 9:
       delayMicroseconds(1247);
       break;
       default:break;
     }
   }
}

void Measure()
{
  V_max=Buffer[0];
  V_min=Buffer[0];   
     
  for(i=0;i<192;i++)  { 
    if(Buffer[i]>V_max) 
      V_max=Buffer[i];
    if(Buffer[i]<V_min) 
      V_min=Buffer[i];
  }
  
  V_mid=(V_max+V_min)/2;  
  Vpp=(V_max-V_min)*5/255; // measure come from ADCH so max value is 255

  //find rising edge
  for(i=0;i<97;i++)  {
    if(Buffer[i]<V_mid && Buffer[i+1]>=V_mid) {
      i1=i;
      break;
    }
  }

  //find next rising edge
  for(i=i1+1;i<98+i1;i++) {
    if(Buffer[i]<V_mid && Buffer[i+1]>=V_mid) {
      i2=i;
      break;
    }
  }
  
  t=i2-i1;
  if(t>0)
    Freq=8000/t;
  else
    Freq=0;
}

 void Transform( )  
{ 
//  find rising endge and save it index in sta variable
  for(sta=0;sta<96;sta++){
    if(Buffer[sta]<128 && Buffer[sta+2]>128)  
      break;
  } 
  
  for(i = 0;i < 96;i++)               // measure come from ADCH so max value is 255, divide by 4 to get 0-64 range
    Y[i] =  63-(Buffer[i+sta]>>2);     // screen Y position starts from 0 on top so substract 63
}                                    // as  y =64 is signal equal to 0 and y = 0 is 5v

void draw( )  
{  
  screen.background(0,0,0);

//draw measured values
  for(x = 0;x < 93;x++)  // 93 instead of 95 to offset graph from left border line by 2 pixels (x+2)
    if(abs(Y[x+1] - Y[x]) < 3)
      screen.line(x+2,Y[x],x+1+2,Y[x+1]);
    else
      screen.line(x+2,Y[x],x+2,Y[x+1]);

  screen.rect(0,0,97,64);// outline

  screen.line(48,0,48,63); //vertical middle line
  screen.line(0,32,96,32); // horizontal line

//div marks?
//  for(x=0;x<96;x+=8)
//    screen.line(x,31,x,33);
//  for(y=0;y<64;y+=8)
//    screen.line(47,y,49,y);

  // draw divisions
  for(x=8;x<96;x+=8){
    for(y=8;y<64;y+=8)
      screen.point(x,y);
  }

   screen.text("MS/div",98,7);
   screen.text("V/div", 98,23);
   screen.text("0.324",98,30);
   screen.text("Vpp", 98,40);
  
   String(Vpp).toCharArray(TEXTE,5); 
   screen.text(TEXTE, 98, 47);
  
   screen.text("V",118,47);
   screen.text("F(HZ)", 98,55);
  
   switch(Key)
   {
        case  1:
        screen.text("0.02", 98,14);
  
        String(Freq*50).toCharArray(TEXTE,5); 
        screen.text(TEXTE, 98, 62);
        break;
  
        case  2:
        screen.text("0.05",98,14);
        String(Freq*20).toCharArray(TEXTE,5); 
        screen.text(TEXTE, 98, 62);
        break;
  
        case  3:
        screen.text(" 0.1", 98,14);
        String(Freq*10).toCharArray(TEXTE,5); 
        screen.text(TEXTE, 98, 62);
        break;
  
        case  4:
        screen.text(" 0.2", 98,14);
        String(Freq*5).toCharArray(TEXTE,5); 
        screen.text(TEXTE, 98, 62);
        break;
  
        case  5:
        screen.text(" 0.5", 98,14);
        String(Freq*2).toCharArray(TEXTE,5); 
        screen.text(TEXTE, 98, 62);
        break;
  
       case  6:
        screen.text("  1", 98,14);
        String(Freq).toCharArray(TEXTE,5); 
        screen.text(TEXTE, 98, 62);
        break;
  
       case  7:
        screen.text("  2",98,14);
        String(Freq/2).toCharArray(TEXTE,5); 
        screen.text(TEXTE, 98, 62);
        break;
  
       case  8:
        screen.text("  5",98,14);
        /*
        String(Freq/5).toCharArray(TEXTE,5); 
        screen.text(TEXTE, 98, 62);
        */
        break;
  
        case  9:
        screen.text(" 10",98,14);
        String(Freq/10).toCharArray(TEXTE,5); 
        screen.text(TEXTE, 98, 62);
        break;
  
      default:
        break;
     }
}


void Key_scan()
{
 if(digitalRead(Key_add)==LOW) 
  {
    while(digitalRead(Key_add)==LOW);
    Key++;
    if(Key==10) Key=9;
    draw();
     
    delay(10);
  } else if (digitalRead(Key_sub)==LOW) {
    while(digitalRead(Key_sub)==LOW);
    Key--;
    if(Key==0) Key=1;
    
    draw();
    delay(10);
  } else if (digitalRead(Key_hold)==LOW) {
    while(digitalRead(Key_hold)==LOW);
    Serial.println("HOLD");
//    for(int i = 0; i < 192; i++){
//      Serial.print(Buffer[i]);
    for(x = 0;x < 95;x++)  {
      Serial.print(Y[x]);
      Serial.print(",");      
    }
    Serial.println();
    
    hold=~hold;
    delay(10);
  }
}
